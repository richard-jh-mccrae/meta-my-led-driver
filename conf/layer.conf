## conf/layer.conf
```bitbake
# We have a conf and classes directory, add to BBPATH
BBPATH .= ":${LAYERDIR}"

BBFILES:prepend = "${LAYERDIR}/recipes-*/*/*.bb \
                 ${LAYERDIR}/recipes-*/linux/*/*.bbappend"

BBFILE_COLLECTIONS += "meta-my-led-driver"
BBFILE_PATTERN_meta-my-led-driver = "^${LAYERDIR}/"
BBFILE_PRIORITY_meta-my-led-driver = "6"

LAYERDEPENDS_meta-my-led-driver = "core"
LAYERSERIES_COMPAT_meta-my-led-driver = "kirkstone"
```
